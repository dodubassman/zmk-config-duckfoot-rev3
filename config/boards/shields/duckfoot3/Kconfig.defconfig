## config/boards/shields/duckfoot3/Kconfig.defconfig
```kconfig
# Copyright (c) 2020 The ZMK Contributors
# SPDX-License-Identifier: MIT

if SHIELD_DUCKFOOT3_LEFT

config ZMK_KEYBOARD_NAME
	default "DuckFootV3"

config ZMK_SPLIT_BLE_ROLE_CENTRAL
	default y

endif

if SHIELD_DUCKFOOT3_LEFT || SHIELD_DUCKFOOT3_RIGHT

config ZMK_SPLIT
	default y

endif
```

## config/boards/shields/duckfoot3/Kconfig.shield
```kconfig
# Copyright (c) 2020 The ZMK Contributors
# SPDX-License-Identifier: MIT

config SHIELD_DUCKFOOT3_LEFT
	def_bool $(shields_list_contains,duckfoot3_left)

config SHIELD_DUCKFOOT3_RIGHT
	def_bool $(shields_list_contains,duckfoot3_right)
```

## config/west.yml
```yaml
manifest:
  remotes:
    - name: zmkfirmware
      url-base: https://github.com/zmkfirmware
    - name: ftc-dodubassman 
      url-base: https://github.com/dodubassman
  projects:
    - name: zmk
      remote: ftc-dodubassman
      revision: mouse-ftc
      import: app/west.yml
  self:
    path: config
```
